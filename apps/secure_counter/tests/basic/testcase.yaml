## apps/secure_counter/tests/basic/testcase.yaml
```yaml
tests:
  secure_counter.basic:
    platform_allow:
      - qemu_x86
      - qemu_x86_64
    tags: counter msgq shell userspace
    build_only: true
    extra_args:
      - CONF_FILE=../../prj.conf
```

## apps/secure_counter/tests/console/testcase.yaml
```yaml
tests:
  secure_counter.console:
    platform_allow:
      - qemu_x86
    tags: counter shell userspace console
    harness: console
    harness_config:
      type: one_line
      regex:
        - ".*secure_counter.*starting.*"
    timeout: 60
```
